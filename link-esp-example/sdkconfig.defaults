## link-esp-example/sdkconfig.defaults
```kconfig
# Optimize for performance instead of size
CONFIG_COMPILER_OPTIMIZATION_PERF=y
CONFIG_COMPILER_OPTIMIZATION_SIZE=n

# Reduce bootloader size
CONFIG_BOOTLOADER_LOG_LEVEL_NONE=y
CONFIG_BOOTLOADER_LOG_LEVEL=0

# Reduce logging level
CONFIG_LOG_DEFAULT_LEVEL_ERROR=y
CONFIG_LOG_DEFAULT_LEVEL=1

CONFIG_COMPILER_CXX_EXCEPTIONS=y
CONFIG_ESP32_DEFAULT_CPU_FREQ_240=y
# CONFIG_ESP_TASK_WDT_CHECK_IDLE_TASK_CPU0 is not set
# CONFIG_ESP_TASK_WDT_CHECK_IDLE_TASK_CPU1 is not set
CONFIG_LINK_TASK_AFFINITY_NO_AFFINITY=y
```

## sdkconfig.defaults
```kconfig
CONFIG_COMPILER_OPTIMIZATION_PERF=y
CONFIG_COMPILER_OPTIMIZATION_SIZE=n

CONFIG_BOOTLOADER_LOG_LEVEL_NONE=y
CONFIG_BOOTLOADER_LOG_LEVEL=0

CONFIG_LOG_DEFAULT_LEVEL_INFO=y
CONFIG_LOG_DEFAULT_LEVEL=3

CONFIG_COMPILER_CXX_EXCEPTIONS=y
CONFIG_ESP32_DEFAULT_CPU_FREQ_240=y
# CONFIG_ESP_TASK_WDT_CHECK_IDLE_TASK_CPU0 is not set
# CONFIG_ESP_TASK_WDT_CHECK_IDLE_TASK_CPU1 is not set
CONFIG_LINK_TASK_AFFINITY_NO_AFFINITY=y

CONFIG_HTTPD_MAX_REQ_HDR_LEN=32768
CONFIG_HTTPD_MAX_URI_LEN=8192

CONFIG_PARTITION_TABLE_CUSTOM=y
CONFIG_PARTITION_TABLE_CUSTOM_FILENAME="partitions_large.csv"

CONFIG_ESPTOOLPY_FLASHSIZE_4MB=y
CONFIG_ESPTOOLPY_FLASHSIZE="4MB"

CONFIG_LWIP_MAX_SOCKETS=16
CONFIG_LWIP_PBUF_POOL_SIZE=32
CONFIG_LWIP_TCPIP_RECVMBOX_SIZE=64
CONFIG_LWIP_UDP_RECVMBOX_SIZE=6
```
